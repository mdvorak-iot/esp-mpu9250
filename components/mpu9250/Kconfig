## components/mpu9250/Kconfig
```kconfig
menu "MPU9250 Configuration"

config MPU9250_I2C_MASTER_NUM
    int "I2C bus port"
    default 0

config MPU9250_I2C_MASTER_SCL_IO
    int "I2C SCL PIN"
    default 22
    help
      gpio number for I2C master clock.
    
config MPU9250_I2C_MASTER_SDA_IO
    int "I2C SDA PIN"
    default 21
    help
      gpio number for I2C master data.

config SAMPLE_RATE_Hz
    int "The sample rate of the MPU9250, in Hz"
    default 200
    help
      This has been tested with 200 Hz, although all possible options should include 50, 100, 200 and 250 Hz.

endmenu
```
